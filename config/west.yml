## config/west.yml
```yaml
manifest:
  remotes:
    - name: zmkfirmware
      url-base: https://github.com/zmkfirmware
    - name: urob
      url-base: https://github.com/urob
    - name: infely                             # new entry
      url-base: https://github.com/infely
    # Additional modules containing boards/shields/custom code can be listed here as well
    # See https://docs.zephyrproject.org/3.2.0/develop/west/manifest.html#projects
  projects:
    - name: zmk
      remote: zmkfirmware
      revision: v0.3
      import: app/west.yml
    - name: zmk-auto-layer
      remote: urob
      revision: v0.3 # set to same version as zmk above 
    - name: nice-view-battery                  # new entry
      remote: infely                           # new entry
      revision: main
    - name: zmk-leader-key
      remote: urob
      revision: v0.3 # Should match ZMK release.
  self:
    path: config
```
